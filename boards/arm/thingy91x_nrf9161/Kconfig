## boards/arm/thingy91x_nrf9161/Kconfig
```kconfig
# Thingy:91 nRF9161 board configuration
#
# Copyright (c) 2019 Nordic Semiconductor ASA
#
# SPDX-License-Identifier: LicenseRef-Nordic-5-Clause

if BOARD_THINGY91X_NRF9161 || BOARD_THINGY91X_NRF9161_NS

config NPM1300_INIT_PRIORITY
	int "Priority for nPM1300 board specific initialization"
	default 70
	help
	  Needs to be after I2C_INIT_PRIORITY and REGULATOR_NPM1300_INIT_PRIORITY, but before
	  REGULATOR_NPM6001_COMMON_INIT_PRIORITY and SENSOR_INIT_PRIORITY

config NPM6001_INIT_PRIORITY
	int "Priority for nPM6001 board specific initialization"
	default 78
	help
	  Needs to be after REGULATOR_NPM6001_INIT_PRIORITY, but before WIFI_INIT_PRIORITY


endif # BOARD_THINGY91X_NRF9161 || BOARD_THINGY91X_NRF9161_NS

module=BOARD
module-dep=LOG
module-str=Log level for board
source "${ZEPHYR_BASE}/subsys/logging/Kconfig.template.log_config"
```

## samples/cellular/slm_shell/boards/thingy91x_nrf5340_cpuapp.conf
```kconfig
#
# Copyright (c) 2024 Nordic Semiconductor ASA
#
# SPDX-License-Identifier: LicenseRef-Nordic-5-Clause
#

CONFIG_SPI=y
CONFIG_FLASH=y
CONFIG_SPI_NOR=y
CONFIG_SPI_NOR_FLASH_LAYOUT_PAGE_SIZE=4096
CONFIG_SPI_NOR_SFDP_DEVICETREE=y
CONFIG_I2C=y

CONFIG_NFCT_PINS_AS_GPIOS=y

# USB
CONFIG_USB_DEVICE_STACK=y
CONFIG_USB_DEVICE_PRODUCT="Thingy:91 X SLM Shell"
CONFIG_USB_CDC_ACM=y
CONFIG_USB_CDC_ACM_LOG_LEVEL_OFF=y
CONFIG_USB_COMPOSITE_DEVICE=y
CONFIG_USB_MASS_STORAGE=n
CONFIG_USB_DEVICE_MANUFACTURER="Nordic Semiconductor"
CONFIG_USB_DEVICE_VID=0x1915
CONFIG_USB_DEVICE_PID=0x910A

CONFIG_USB_DEVICE_REMOTE_WAKEUP=n
CONFIG_USB_DEVICE_INITIALIZE_AT_BOOT=y

CONFIG_USE_SEGGER_RTT=n
CONFIG_RTT_CONSOLE=n

CONFIG_FW_INFO=y
CONFIG_SECURE_BOOT_STORAGE=y

# SLM shell settings
CONFIG_NRFX_UARTE0=y
CONFIG_UART_0_INTERRUPT_DRIVEN=n
CONFIG_UART_0_ASYNC=y
CONFIG_MODEM_SLM_POWER_PIN=15
#CONFIG_MODEM_SLM_INDICATE_PIN= # We do not have a INDICATE pin yet
```
