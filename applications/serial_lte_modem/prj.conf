## CMakeLists.txt
```
#
# Copyright (c) 2019 Nordic Semiconductor
#
# SPDX-License-Identifier: LicenseRef-Nordic-5-Clause
#

cmake_minimum_required(VERSION 3.13.1)

find_package(Zephyr REQUIRED HINTS $ENV{ZEPHYR_BASE})
project(serial_lte_modem)

# NORDIC SDK APP START
target_sources(app PRIVATE src/main.c)
target_sources(app PRIVATE src/slm_util.c)
target_sources(app PRIVATE src/slm_settings.c)
target_sources(app PRIVATE src/slm_at_host.c)
target_sources(app PRIVATE src/slm_at_commands.c)
target_sources(app PRIVATE src/slm_at_socket.c)
target_sources(app PRIVATE src/slm_at_tcp_proxy.c)
target_sources(app PRIVATE src/slm_at_udp_proxy.c)
target_sources(app PRIVATE src/slm_at_icmp.c)
target_sources(app PRIVATE src/slm_at_fota.c)
# NORDIC SDK APP END
target_sources_ifdef(CONFIG_SLM_SMS app PRIVATE src/slm_at_sms.c)
target_sources_ifdef(CONFIG_SLM_NATIVE_TLS app PRIVATE src/slm_native_tls.c)
target_sources_ifdef(CONFIG_SLM_NATIVE_TLS app PRIVATE src/slm_at_cmng.c)
target_sources_ifdef(CONFIG_SLM_NATIVE_TLS_PS app PRIVATE src/slm_native_tls_ps.c)

add_subdirectory_ifdef(CONFIG_SLM_GPS src/gps)
add_subdirectory_ifdef(CONFIG_SLM_FTPC src/ftp_c)
add_subdirectory_ifdef(CONFIG_SLM_MQTTC src/mqtt_c)
add_subdirectory_ifdef(CONFIG_SLM_HTTPC src/http_c)
add_subdirectory_ifdef(CONFIG_SLM_TWI src/twi)

zephyr_include_directories(src)
```

## Kconfig
```
#
# Copyright (c) 2019 Nordic Semiconductor
#
# SPDX-License-Identifier: LicenseRef-Nordic-5-Clause
#

source "Kconfig.zephyr"

menu "Nordic Serial LTE Modem"

config SLM_CUSTOMIZED
	bool "Flag for customized functionality"
	help
	  Enable this flag to include customized logic.

config SLM_AT_MODE
	bool "Serial LTE Modem by raw AT mode"
	default y
	select AT_CMD
	select AT_NOTIF
	select AT_CMD_PARSER

config SLM_AT_MAX_PARAM
	int "Maximum number of parameters in AT command"
	default 9

menuconfig SLM_NATIVE_TLS
	bool "Use Zephyr mbedTLS"

if SLM_NATIVE_TLS

choice
	prompt "Credential storage backend"
	default SLM_NATIVE_TLS_PS if TFM_PARTITION_PROTECTED_STORAGE
	default SLM_NATIVE_TLS_MODEM
	help
		Select which mechanism is used to store credentials
	config SLM_NATIVE_TLS_MODEM
		bool "Modem storage"
		help
		  Credentials will be stored in the nRF9160 modem's storage.
		  Security tag value will be offset and CA certificate slots are
		  used. For details, see the slm_tls_map_sectag function.
	config SLM_NATIVE_TLS_PS
		bool "Protected Storage (TF-M)"
		depends on TFM_PARTITION_PROTECTED_STORAGE
		help
		  Credentials will be stored using the PSA Protected Storage
		  API. This requires that the application be built with TF-M.
endchoice

if SLM_NATIVE_TLS_PS
config SLM_NATIVE_TLS_PS_WRITE_ONCE
	bool "Write-once credentials"
	default n
	help
		Credentials are written with the "write-once" attribute, meaning
		that they cannot be modified, replaced or deleted by firmware.
endif

endif # SLM_NATIVE_TLS


#
# external XTAL for UART
#
config SLM_EXTERNAL_XTAL
	bool "Use external XTAL for UARTE"
	default y

#
# Inter-Connect
#
choice
	prompt "UART for interconnect"
	default SLM_CONNECT_UART_0
	help
		Selects which UART to use for interconnect:
		-  UART 0
		-  UART 2
	config SLM_CONNECT_UART_0
		bool "UART 0"
	  select UART_0_NRF_HW_ASYNC
	config SLM_CONNECT_UART_2
		bool "UART 2"
	  select UART_2_NRF_UARTE
	  select UART_2_NRF_HW_ASYNC
endchoice

choice
	prompt "Termination mode"
	default SLM_CR_LF_TERMINATION
	help
		Sets the command terminator used by the serial terminal.
		Available options are:
		-  CR termination
		-  LF termination
		-  CR+LF termination
	config SLM_CR_TERMINATION
		bool "CR termination"
	config SLM_LF_TERMINATION
		bool "LF termination"
	config SLM_CR_LF_TERMINATION
		bool "CR+LF termination"
endchoice

#
# GPIO wakeup
#
config SLM_START_SLEEP
	bool "Enter sleep on startup"
	help
	  Put nRF9160 into deep sleep mode after startup.

config SLM_INTERFACE_PIN
	int "Interface GPIO to wake up or exit idle mode"
	default 6 if SLM_CONNECT_UART_0
	default 31 if SLM_CONNECT_UART_2

#
# Socket
#
config SLM_SOCKET_RX_MAX
	int "Maximum RX buffer size for receiving socket data"
	range 576 708
	default 576
	help
	  Default: NET_IPV4_MTU (576)
	  Maximum: MSS setting in modem (708)

#
# TCP/TLS proxy
#
config SLM_TCP_POLL_TIME
	int "Poll time-out in seconds for TCP connection"
	default 10

config SLM_UDP_POLL_TIME
	int "Poll time-out in seconds for UDP connection"
	default 10

#
# Data mode
#
config SLM_DATAMODE_TERMINATOR
	string "Pattern string to terminate data mode"
	default "+++"
	help
	  Use a pattern to terminate data mode

config SLM_DATAMODE_SILENCE
	int "Silence time to exit data mode"
	default 1
	help
	  Exit data mode after the specified time (in seconds) of UART silence

#
# Configurable services
#
config SLM_SMS
	bool "SMS support in SLM"
	default y
	select SMS
	help
	  Support SMS send/receive in plain text

rsource "src/gps/Kconfig"
rsource "src/ftp_c/Kconfig"
rsource "src/mqtt_c/Kconfig"
rsource "src/http_c/Kconfig"
rsource "src/twi/Kconfig"

module = SLM
module-str = serial modem
source "${ZEPHYR_BASE}/subsys/logging/Kconfig.template.log_config"

endmenu
```

## prj.conf
```kconfig
#
# Copyright (c) 2020 Nordic Semiconductor ASA
#
# SPDX-License-Identifier: LicenseRef-Nordic-5-Clause
#
# General config
CONFIG_LOG=y
CONFIG_LOG_DEFAULT_LEVEL=2
CONFIG_STACK_SENTINEL=y
CONFIG_NEWLIB_LIBC=y
CONFIG_NEWLIB_LIBC_FLOAT_PRINTF=y
CONFIG_RING_BUFFER=y

# Segger RTT
CONFIG_USE_SEGGER_RTT=y
CONFIG_RTT_CONSOLE=y
CONFIG_UART_CONSOLE=n
CONFIG_LOG_BACKEND_RTT=y
CONFIG_LOG_BACKEND_UART=n

# Network
CONFIG_NETWORKING=y
CONFIG_NET_SOCKETS=y
CONFIG_NET_NATIVE=n

# Modem library
CONFIG_NRF_MODEM_LIB=y
# Align the max FD entry to NRF_MODEM_MAX_SOCKET_COUNT(8)
CONFIG_POSIX_MAX_FDS=8
# Enable below for modem trace
#CONFIG_NRF_MODEM_LIB_TRACE_ENABLED=y

# Use GPIO
CONFIG_GPIO=y
CONFIG_GPIO_NRFX=y
CONFIG_GPIO_NRF_P0=y

# UART interface
CONFIG_SERIAL=y
CONFIG_UART_ASYNC_API=y
CONFIG_NRFX_TIMER2=y

# Stacks and heaps
CONFIG_MAIN_STACK_SIZE=4096
CONFIG_HEAP_MEM_POOL_SIZE=16384
CONFIG_SYSTEM_WORKQUEUE_STACK_SIZE=4096

# AT_CMD
# Enable AT_CMD debug for details
#CONFIG_AT_CMD_LOG_LEVEL_DBG=y

# Device power management
CONFIG_PM_DEVICE=y

# Enable SUPL client support
#CONFIG_SUPL_CLIENT_LIB=y

# FOTA
CONFIG_HTTP_PARSER_URL=y
CONFIG_FOTA_DOWNLOAD=y
CONFIG_FOTA_DOWNLOAD_PROGRESS_EVT=y
CONFIG_DFU_TARGET=y
CONFIG_DOWNLOAD_CLIENT=y
CONFIG_DOWNLOAD_CLIENT_STACK_SIZE=4096
CONFIG_IMG_MANAGER=y

# FLASH
CONFIG_FLASH=y
CONFIG_FLASH_PAGE_LAYOUT=y
CONFIG_FLASH_MAP=y
CONFIG_MPU_ALLOW_FLASH_WRITE=y
CONFIG_IMG_ERASE_PROGRESSIVELY=y

# Settings
CONFIG_SETTINGS=y
CONFIG_SETTINGS_FCB=y
CONFIG_FCB=y

# FLASH
CONFIG_FLASH=y
CONFIG_FLASH_PAGE_LAYOUT=y
CONFIG_FLASH_MAP=y
#CONFIG_MPU_ALLOW_FLASH_WRITE=n


#
# SLM-specific configurations
#
CONFIG_SLM_CUSTOMIZED=n
#CONFIG_SLM_LOG_LEVEL_INF=y
CONFIG_SLM_LOG_LEVEL_WRN=y
CONFIG_SLM_EXTERNAL_XTAL=n
CONFIG_SLM_START_SLEEP=n
# Use UART_0 (when working with PC terminal)
CONFIG_UART_0_NRF_HW_ASYNC_TIMER=2
# Use UART_2 (when working with external MCU)
#CONFIG_SLM_CONNECT_UART_2=y
#CONFIG_UART_2_NRF_HW_ASYNC_TIMER=2

# TF-M
CONFIG_BOOTLOADER_MCUBOOT=y
CONFIG_BUILD_WITH_TFM=y
CONFIG_TFM_MCUBOOT_IMAGE_NUMBER=1
CONFIG_PM_PARTITION_SIZE_TFM=0x31000
CONFIG_PM_PARTITION_SIZE_TFM_EXTRA=0xe000


# Unneccessary MBED TLS ciphers
CONFIG_MBEDTLS_CTR_DRBG_C=n
CONFIG_MBEDTLS_CIPHER_MODE_CBC=n
CONFIG_MBEDTLS_CHACHA20_C=n
CONFIG_MBEDTLS_POLY1305_C=n
CONFIG_MBEDTLS_SHA1_C=n
CONFIG_MBEDTLS_SHA512_C=n
CONFIG_MBEDTLS_DHM_C=n
CONFIG_MBEDTLS_CMAC_C=n
CONFIG_MBEDTLS_ECDSA_DETERMINISTIC=n
CONFIG_MBEDTLS_ECDH_C=n

# Unneccessary SLM features
CONFIG_SLM_HTTPC=n
CONFIG_SLM_MQTTC=n
```

## overlay-native_tls.conf
```kconfig
# To build serial LTE modem native TLS socket support
# add the following to your west build command:
#       -DOVERLAY_CONFIG=overlay-native_tls.conf
#

# TLS configuration
CONFIG_SLM_NATIVE_TLS=y
CONFIG_MODEM_KEY_MGMT=y
CONFIG_MBEDTLS_TLS_LIBRARY=y
CONFIG_MBEDTLS_RSA_C=y
CONFIG_MBEDTLS_PKCS1_V15=y
CONFIG_MBEDTLS_ENABLE_HEAP=y
# If larger TLS buffer is required for large CA chain,
# increase CONFIG_MBEDTLS_SSL_MAX_CONTENT_LEN to 4096
# and CONFIG_MBEDTLS_HEAP_SIZE to 32768
CONFIG_MBEDTLS_SSL_MAX_CONTENT_LEN=1280
CONFIG_MBEDTLS_HEAP_SIZE=23040
#CONFIG_MBEDTLS_SSL_MAX_CONTENT_LEN=4096
#CONFIG_MBEDTLS_HEAP_SIZE=32768
CONFIG_NET_SOCKETS_OFFLOAD_TLS=n
CONFIG_NET_SOCKETS_SOCKOPT_TLS=y
CONFIG_NET_SOCKETS_TLS_MAX_CONTEXTS=2
# Increase extra FD entry for TLS contexts(2)
CONFIG_POSIX_MAX_FDS=10
CONFIG_NORDIC_SECURITY_BACKEND=y
CONFIG_NRF_SECURITY_ADVANCED=y
# Enable Socket Logging for debug
#CONFIG_NET_LOG=y
#CONFIG_NET_SOCKETS_LOG_LEVEL_DBG=y
```

## src/slm_at_cmng.c
```c
/*
 * Copyright (c) 2020 Nordic Semiconductor ASA
 *
 * SPDX-License-Identifier: LicenseRef-Nordic-5-Clause
 */
#include <logging/log.h>
#include <zephyr.h>
#include <stdio.h>
#include <string.h>
#include <net/socket.h>
#include <modem/modem_info.h>
#include <modem/modem_key_mgmt.h>
#include "slm_util.h"
#include "slm_native_tls.h"
#include "slm_at_host.h"
#include "slm_at_cmng.h"

LOG_MODULE_REGISTER(slm_cmng, CONFIG_SLM_LOG_LEVEL);

/**@brief List of supported opcode */
enum slm_cmng_opcode {
	AT_CMNG_OP_WRITE,
	AT_CMNG_OP_LIST,
	AT_CMNG_OP_READ,
	AT_CMNG_OP_DELETE
};

/**@brief List of supported type */
enum slm_cmng_type {
	AT_CMNG_TYPE_CA_CERT,
	AT_CMNG_TYPE_CERT,
	AT_CMNG_TYPE_PRIV,
	AT_CMNG_TYPE_PSK,
	AT_CMNG_TYPE_PSK_ID,
};

/* global variable defined in different files */
extern struct at_param_list at_param_list;
extern char rsp_buf[CONFIG_AT_CMD_RESPONSE_MAX_LEN];

/**@brief handle AT#XCMNG commands
 *  AT#XCMNG=<opcode>[,<sec_tag>[,<type>[,<content>]]]
 *  AT#XCMNG? READ command not supported
 *  AT#XCMNG=? READ command not supported
 */
int handle_at_xcmng(enum at_cmd_type cmd_type)
{
	int err = -EINVAL;
	uint16_t op, type;
	nrf_sec_tag_t sec_tag;
	uint8_t *content;
	size_t len = CONFIG_AT_CMD_RESPONSE_MAX_LEN;

	switch (cmd_type) {
	case AT_CMD_TYPE_SET_COMMAND:
		if (at_params_valid_count_get(&at_param_list) < 2) {
			LOG_ERR("Parameter missed");
			return -EINVAL;
		}
		err = at_params_unsigned_short_get(&at_param_list, 1, &op);
		if (err < 0) {
			LOG_ERR("Fail to get op parameter: %d", err);
			return err;
		}
		if (op > AT_CMNG_OP_DELETE) {
			LOG_ERR("Wrong XCMNG operation: %d", op);
			return -EPERM;
		}
		if (op == AT_CMNG_OP_LIST) {
			/* Currently not support list command */
			LOG_ERR("XCMNG List is not supported");
			return -EPERM;
		}
		if (at_params_valid_count_get(&at_param_list) < 4) {
			/* READ, WRITE, DELETE requires sec_tag and type */
			LOG_ERR("Parameter missed");
			return -EINVAL;
		}
		err = at_params_unsigned_int_get(&at_param_list, 2, &sec_tag);
		if (err < 0) {
			LOG_ERR("Fail to get sec_tag parameter: %d", err);
			return err;
		};
		if (sec_tag > MAX_SLM_SEC_TAG) {
			LOG_ERR("Invalid security tag: %d", sec_tag);
			return -EINVAL;
		}
		err = at_params_unsigned_short_get(&at_param_list, 3, &type);
		if (err < 0) {
			LOG_ERR("Fail to get type parameter: %d", err);
			return err;
		};
		if (op == AT_CMNG_OP_WRITE) {
			if (at_params_valid_count_get(&at_param_list) < 5) {
				/* WRITE requires sec_tag, type and content */
				LOG_ERR("Parameter missed");
				return -EINVAL;
			}
			content = k_malloc(CONFIG_AT_CMD_RESPONSE_MAX_LEN);
			err = util_string_get(&at_param_list, 4, content,
						   &len);
			if (err != 0) {
				LOG_ERR("Failed to get content");
				k_free(content);
				return err;
			}
			err = slm_tls_storage_set(sec_tag, type, content, len);
			if (err != 0) {
				LOG_ERR("FAILED! modem_key_mgmt_write() = %d",
					err);
			}
			k_free(content);
		} else if (op == AT_CMNG_OP_READ) {
			if (type == AT_CMNG_TYPE_CERT ||
			   type == AT_CMNG_TYPE_PRIV ||
			   type == AT_CMNG_TYPE_PSK) {
				/* Not supported */
				LOG_ERR("Not support READ for type: %d", type);
				return -EPERM;
			}
			content = k_malloc(CONFIG_AT_CMD_RESPONSE_MAX_LEN);
			err = slm_tls_storage_get(sec_tag, type, content,
						CONFIG_AT_CMD_RESPONSE_MAX_LEN,
						&len);
			if (err != 0) {
				LOG_ERR("FAILED! modem_key_mgmt_read() = %d",
					err);
			} else {
				*(content + len) = '\0';
				sprintf(rsp_buf, "%%CMNG: %d,%d,\"\","
					"\"%s\"\r\n", sec_tag, type, content);
				rsp_send(rsp_buf, strlen(rsp_buf));
			}
			k_free(content);
		} else if (op == AT_CMNG_OP_DELETE) {
			err = slm_tls_storage_remove(sec_tag, type);
			if (err != 0) {
				LOG_ERR("FAILED! modem_key_mgmt_delete() = %d",
					err);
			}
		}
		break;

	default:
		break;
	}

	return err;
}

/**@brief API to initialize CMNG AT commands handler
 */
int slm_at_cmng_init(void)
{
	return 0;
}

/**@brief API to uninitialize CMNG AT commands handler
 */
int slm_at_cmng_uninit(void)
{
	return 0;
}
```

## src/slm_native_tls.c
```c
/*
 * Copyright (c) 2020 Nordic Semiconductor ASA
 *
 * SPDX-License-Identifier: LicenseRef-Nordic-5-Clause
 */
#include <net/socket.h>
#include <modem/modem_key_mgmt.h>
#include "slm_native_tls_ps.h"
#include "slm_native_tls.h"

LOG_MODULE_REGISTER(slm_tls, CONFIG_SLM_LOG_LEVEL);

/* max buffer length to load credential */
#define MAX_CRDL_LEN		4096

/* pointer to credential buffer */
static uint8_t *crdl;

/**
 * @brief Map SLM security tag to nRF security tag
 */
nrf_sec_tag_t slm_tls_map_sectag(sec_tag_t sec_tag, uint16_t type)
{
	if (sec_tag > MAX_SLM_SEC_TAG || sec_tag < MIN_SLM_SEC_TAG) {
		LOG_ERR("Invalid security tag.");
		return -EINVAL;
	}

	return sec_tag*10 + type;
}

/**
 * @brief Write TLS credential to storage
 */
int slm_tls_storage_set(sec_tag_t sec_tag, uint16_t type, const void *buf,
			size_t len)
{
	if(IS_ENABLED(CONFIG_SLM_NATIVE_TLS_PS)) {
		return slm_tls_ps_set(sec_tag, type, buf, len);
	}
	
	return modem_key_mgmt_write(slm_tls_map_sectag(sec_tag, type),
					    0, buf, len);
}

/**
 * @brief Read TLS credential from storage
 */
int slm_tls_storage_get(sec_tag_t sec_tag, uint16_t type, void *buf,
			size_t buf_len, size_t *len)
{
	if(IS_ENABLED(CONFIG_SLM_NATIVE_TLS_PS)) {
		return slm_tls_ps_get(sec_tag, type, buf, buf_len, len);
	}
	
	return modem_key_mgmt_read(slm_tls_map_sectag(sec_tag, type),
					   0, buf, len);
}

/**
 * @brief Remove TLS credential from storage
 */
int slm_tls_storage_remove(sec_tag_t sec_tag, uint16_t type)
{
	if(IS_ENABLED(CONFIG_SLM_NATIVE_TLS_PS)) {
		return slm_tls_ps_remove(sec_tag, type);
	}
	
	return modem_key_mgmt_delete(slm_tls_map_sectag(sec_tag, type),
					     0);
}

/**
 * @brief Load TLS credentials
 */
int slm_tls_loadcrdl(sec_tag_t sec_tag)
{
	int ret, len = MAX_CRDL_LEN, offset = 0;
	bool loaded = false;

	if (sec_tag > MAX_SLM_SEC_TAG || sec_tag < MIN_SLM_SEC_TAG) {
		LOG_ERR("Invalid security tag.");
		return -EINVAL;
	}

	crdl = k_malloc(MAX_CRDL_LEN);
	if (crdl == NULL) {
		LOG_ERR("Fail to allocate memory");
		return -ENOMEM;
	}
	memset(crdl, 0, MAX_CRDL_LEN);

	/* Load CA certificate */
	ret = slm_tls_storage_get(sec_tag, 0, crdl + offset, len, &len);
	if (ret == 0) {
		LOG_DBG("Load CA cert %d: Len: %d", sec_tag, len);
		len++;
		ret = tls_credential_add(sec_tag, TLS_CREDENTIAL_CA_CERTIFICATE,
					crdl + offset, len);
		if (ret != 0) {
			LOG_ERR("Failed to register CA certificate: %d", ret);
			goto exit;
		}
		offset += len;
		len = MAX_CRDL_LEN - offset;
		loaded = true;
	} else {
		LOG_DBG("Empty CA cert at %d:", sec_tag);
	}

	/* Load server/client certificate */
	ret = slm_tls_storage_get(sec_tag, 1, crdl + offset, len, &len);
	if (ret == 0) {
		LOG_DBG("Load cert %d. Len: %d", sec_tag, len);
		len++;
		ret = tls_credential_add(sec_tag,
					TLS_CREDENTIAL_SERVER_CERTIFICATE,
					crdl + offset, len);
		if (ret < 0) {
			LOG_ERR("Failed to register public cert: %d", ret);
			goto exit;
		}
		offset += len;
		len = MAX_CRDL_LEN - offset;
		loaded = true;
	} else {
		LOG_DBG("Empty cert at %d:", sec_tag);
	}

	/* Load private key */
	ret = slm_tls_storage_get(sec_tag, 2, crdl + offset, len, &len);
	if (ret == 0) {
		LOG_DBG("Load private key %d. Len: %d", sec_tag, len);
		len++;
		ret = tls_credential_add(sec_tag, TLS_CREDENTIAL_PRIVATE_KEY,
					crdl + offset, len);
		if (ret < 0) {
			LOG_ERR("Failed to register private key: %d", ret);
			goto exit;
		}
		loaded = true;
	} else {
		LOG_DBG("Empty private key at %d:", sec_tag);
	}

	if (loaded) {
		/* Load credential successfully */
		return 0;
	}
	LOG_ERR("No credential for sec_tag:%d", sec_tag);
	ret = -EINVAL;

exit:
	k_free(crdl);
	return ret;
}

/**
 * @brief Unload TLS credentials
 */
int slm_tls_unloadcrdl(sec_tag_t sec_tag)
{
	if (sec_tag > MAX_SLM_SEC_TAG || sec_tag < MIN_SLM_SEC_TAG) {
		LOG_ERR("Invalid security tag.");
		return -EINVAL;
	}
	tls_credential_delete(sec_tag, TLS_CREDENTIAL_CA_CERTIFICATE);
	tls_credential_delete(sec_tag, TLS_CREDENTIAL_SERVER_CERTIFICATE);
	tls_credential_delete(sec_tag, TLS_CREDENTIAL_PRIVATE_KEY);
	k_free(crdl);

	return 0;
}
```

## src/slm_native_tls.h
```c
/*
 * Copyright (c) 2020 Nordic Semiconductor ASA
 *
 * SPDX-License-Identifier: LicenseRef-Nordic-5-Clause
 */

#ifndef SLM_NATIVE_TLS_
#define SLM_NATIVE_TLS_

/**@file slm_native_tls.h
 *
 * @brief Utility functions for serial LTE modem native TLS socket
 * @{
 */

#include <zephyr/types.h>
#include <net/tls_credentials.h>
#include <modem/modem_key_mgmt.h>

#define MAX_SLM_SEC_TAG (INT_MAX/10)
#define MIN_SLM_SEC_TAG 0

/**
 * @brief Map SLM security tag to nRF security tag
 * When SLM native TLS is enabled, the credentials are mapped to
 * continuous security tags in modem and stored as Root CA certificate
 * so that the credentials can be read from modem.
 *
 * The available sec_tag in modem (0 – 2147483647) are divided by 10
 * to store mapped credentials:
 *   Root CA certificate (ASCII text) at sec_tag*10 + 0
 *   Client/Server certificate (ASCII text) at sec_tag*10 + 1
 *   Client/Server private key (ASCII text) at sec_tag*10 + 2
 *   Pre-shared Key (PSK) at sec_tag*10 + 3
 *   PSK identity (ASCII text) at sec_tag*10 + 4
 *   Public Key (ASCII text) at sec_tag*10 + 5
 *
 *   Currently PSK, PSK identity and Public Key are not supported.
 *
 * @param[in]  sec_tag SLM security tag of the credential
 * @param[in]  type TLS credential types
 *
 * @return Non-negative nRF security tag if successful,
 *         negative error code if failure.
 */
nrf_sec_tag_t slm_tls_map_sectag(sec_tag_t sec_tag, uint16_t type);

/**
 * @brief Store a TLS credential in storage
 *
 * @param[in]  sec_tag security tag of the credential
 * @param[in]  type TLS credential type, as used in AT%CMNG
 * @param[in]  buf Buffer containing the credential
 * @param[in]  len Size of the credential
 *
 * @return 0 if successful, negative error code if failure.
 */
int slm_tls_storage_set(sec_tag_t sec_tag, uint16_t type, const void *buf,
			size_t len);

/**
 * @brief Get a TLS credential from storage
 *
 * @param[in]  sec_tag security tag of the credential
 * @param[in]  type TLS credential type, as used in AT%CMNG
 * @param[out] buf Buffer in which to write the credential
 * @param[in]  buf_len Size of the buffer
 * @param[out] len Size of the credential
 *
 * @return 0 if successful, negative error code if failure.
 */
int slm_tls_storage_get(sec_tag_t sec_tag, uint16_t type, void *buf,
			size_t buf_len, size_t *len);

/**
 * @brief Remove a TLS credential from storage
 *
 * @param[in]  sec_tag security tag of the credential
 * @param[in]  type TLS credential type, as used in AT%CMNG
 *
 * @return 0 if successful, negative error code if failure.
 */
int slm_tls_storage_remove(sec_tag_t sec_tag, uint16_t type);

/**
 * @brief Load credential
 *
 * @param[in] sec_tag TLS reference
 *
 * @return 0 if successful, negative error code if failure.
 */
int slm_tls_loadcrdl(sec_tag_t sec_tag);

/**
 * @brief Unload credential
 *
 * @param[in] sec_tag TLS reference
 *
 * @return 0 if successful, negative error code if failure.
 */
int slm_tls_unloadcrdl(sec_tag_t sec_tag);

/** @} */

#endif /* SLM_NATIVE_TLS_ */
```
