## CMakeLists.txt
```
#
# Copyright (c) 2018 Nordic Semiconductor
#
# SPDX-License-Identifier: LicenseRef-BSD-5-Clause-Nordic
#

cmake_minimum_required(VERSION 3.8.2)

set(spm_CONF_FILE ${CMAKE_CURRENT_SOURCE_DIR}/spm.conf)

include($ENV{ZEPHYR_BASE}/../nrf/cmake/boilerplate.cmake)
include($ENV{ZEPHYR_BASE}/cmake/app/boilerplate.cmake NO_POLICY_SCOPE)
project(asset_tracker)
zephyr_compile_definitions(PROJECT_NAME=${PROJECT_NAME})
zephyr_compile_definitions(_POSIX_C_SOURCE=200809L)

# NORDIC SDK APP START
target_sources(app PRIVATE src/main.c)
# NORDIC SDK APP END
zephyr_include_directories(src)

# Include application events and configuration headers
zephyr_library_include_directories(
  src/orientation_detector
  src/ui
  src/cloud_codec
  src/env_sensors
  src/light_sensor
  src/watchdog
  )

# Application sources
add_subdirectory(src/motion)
add_subdirectory(src/ui)
add_subdirectory(src/cloud_codec)
add_subdirectory(src/env_sensors)
add_subdirectory_ifdef(CONFIG_WATCHDOG src/watchdog)
add_subdirectory_ifdef(CONFIG_LIGHT_SENSOR src/light_sensor)

if (CONFIG_USE_BME680_BSEC)
  target_link_libraries(app PUBLIC bsec_lib)
endif()
```

## Kconfig
```
#
# Copyright (c) 2018 Nordic Semiconductor ASA
#
# SPDX-License-Identifier: LicenseRef-BSD-5-Clause-Nordic
#

menu "Asset tracker"

rsource "src/ui/Kconfig"

config APPLICATION_WORKQUEUE_STACK_SIZE
	int "Application workqueue stack size"
	default 2048

config APPLICATION_WORKQUEUE_PRIORITY
	int "Application workqueue priority"
	default SYSTEM_WORKQUEUE_PRIORITY

menu "GPS"

choice
	prompt "GPS device"
	default GPS_USE_SIM
	help
		Select from which device GPS data will be fetched.

config GPS_USE_SIM
	bool "Use GPS simulator"
	select GPS_SIM
	select GPS_SIM_TRIGGER
	help
		Use simulated GPS data.

config GPS_USE_EXTERNAL
	bool "User provided GPS device"
	help
		Provide a GPS device that location data will be fetched from and
		sent to nRF Cloud

endchoice


menu "GPS"

config GPS_CONTROL
	bool "GPS controller module for nRF9160 GPS"
	default y if BOARD_NRF9160_PCA20035NS
	select NRF9160_GPS

config GPS_CONTROL_ON_LONG_PRESS
	bool "Control the GPS state with button"
	default y
	help
	  Control the GPS operation with long-press on the button.
	  Press for 5 seconds to enable, or 5 seconds to disable.

config GPS_CONTROL_PSM_ENABLE_ON_START
	bool "Enable PSM when starting GPS"
	default y
	help
	  The nRF9160 modem needs to be set in PSM mode for the GPS to start
	  searching for satellites. Enabling this option will do so
	  automatically, otherwise the application must handle it.

config GPS_CONTROL_PSM_DISABLE_ON_STOP
	bool "Disable PSM when stopping GPS"
	default y
	help
	  Selecting this option will disable PSM when the GPS is stopped.
	  During a PSM interval, the device is not reachable from the outside
	  until the interval times out, or the device itself attempts to
	  send data on the link.

config GPS_CONTROL_FIRST_FIX_CHECK_DELAY
	int "Time from Cloud conenction until first fix check"
	default 30
	help
	  The amount of time that should pass between successfully establishing
	  connection to cloud until first attempt to get position fix.
	  Attempting to get a fix means entering PSM mode, in which the device
	  is not reachable for the duration of the interval, or until the
	  device itself sends data and then for the duration for the set
	  active time thereafter.

config GPS_CONTROL_FIX_CHECK_INTERVAL
	int "Interval in seconds to between check for position fix"
	default 120
	help
	  The fix check interval gives the interval for how long it will go
	  between each retry to achieve position fix. The actual fix time will
	  vary with factors such as satellite coverage, surrounding buildings
	  and landscape, PSM interval and activty time requested and granted
	  by the network.

config GPS_CONTROL_FIX_TRY_TIME
	int "Time in seconds to try to get fix"
	default 180
	help
	  Amount of time the device will attempt to get position fix. Note that
	  if the interval is interrupted by the device sending data, the timer
	  is not reset, and the actual try time will be shortened due to
	  the device not being in PSM mode all the time. If fix is not acquired
	  before it times out, the device will try to get fix again in
	  GPS_CONTROL_FIX_CHECK_INTERVAL seconds. If GPS_CONTROL_FIX_COUNT is reached
	  before the full GPS_CONTROL_FIX_TRY_TIME has passed, the GPS will be stopped.

config GPS_CONTROL_FIX_COUNT
	int "Number of position fix before stopping GPS"
	default 3
	help
	  The number of fixes to get before stopping the GPS, within the time
	  set in GPS_CONTROL_FIX_CHECK_INTERVAL.

config GPS_CONTROL_MAX_FAILED_FIX_ATTEMPTS
	int "Number of failed fix attempts before stopping GPS"
	default 3
	help
	  Number of retries to get fix before shutting down the GPS until user
	  input tells it to start retrying.

endmenu


config GPS_DEV_NAME
	string "GPS device name"
	default GPS_SIM_DEV_NAME if GPS_USE_SIM
	help
		GPS device from which location data will be fetched and sent
		to nRF Cloud.

config GPS_TRIGGER
	bool
	default GPS_SIM_TRIGGER if GPS_USE_SIM

config GPS_SIM_TRIGGER_TIMER_MSEC
	int
	default 120000 if POWER_OPTIMIZATION_ENABLE
	default 2000

endmenu	# GPS

menu "Device and modem"

config POWER_OPTIMIZATION_ENABLE
	bool "Enable power optimization"
	default y
	select LTE_EDRX_REQ

if MODEM_INFO

config HOLD_TIME_RSRP
	int "Minimum time [s] between RSRP subscription messages"
	default 60
	help
		The minimum time in seconds where the modem
		informer is allowed to submit RSRP data to the cloud.

endif

endmenu # Device

menu "Motion"

choice
	prompt "Accelerometer device"
	default ACCEL_USE_SIM
	help
		Select which device will provide accelerometer data.

config ACCEL_USE_SIM
	bool "Use simulated accelerometer data"
	select SENSOR
	select SENSOR_SIM
	select SENSOR_SIM_TRIGGER
	select SENSOR_SIM_STATIC_VALUES
	help
		Use sensor simulator to generate accelerometer data for
		flip detection data sent to nRF Cloud.

config ACCEL_USE_EXTERNAL
	bool "User provided accelerometer device"
	help
		The user will provide an accelerometer device that will
		be used for flip detection.

endchoice

if ACCEL_USE_SIM
config ACCEL_DEV_NAME
	string
	default SENSOR_SIM_DEV_NAME

config ACCEL_TRIGGER
	bool
	default SENSOR_SIM_TRIGGER

config FLIP_INPUT
	int "Button or switch number to simulate flip"
	range 1 4 if BOARD_NRF9160_PCA10090NS
	range 1 1 if BOARD_NRF9160_PCA20035NS
	default 3 if BOARD_NRF9160_PCA10090NS
	default 1 if BOARD_NRF9160_PCA20035NS
	help
		Button or switch number to use for simulating
		a board flip event.
		1 - Button 1
		2 - Button 2
		3 - Switch 1
		4 - Switch 2
endif

if ACCEL_USE_EXTERNAL

config ACCEL_DEV_NAME
	string "Accelerometer device name"
	help
		Device from which accelerometer data will be fetched and used
		for orientation detection and sent to nRF Cloud.

endif

config ACCEL_INVERTED
	bool "Accelerometer inverted"
	default y if BOARD_NRF9160_PCA20035NS
	help
		Enable if the accelerometer is mounted with the top side facing
		down when the board itself is in normal position.

endmenu # Motion

menu "Cloud"

config MQTT_KEEPALIVE
	int
	default 1200

config CLOUD_BUTTON
	bool "Enable button sensor"
	default y

config CLOUD_BUTTON_INPUT
	int "Enable button sensor"
	range 1 4 if BOARD_NRF9160_PCA10090NS
	range 1 1 if BOARD_NRF9160_PCA20035NS
	default 1

config CLOUD_WAIT_DURATION
	int "Cloud connection acknowledge wait duration"
	default 30
	help
	    How long the device should wait for a CONNACK
	    event from the cloud.

choice
	prompt "nRF Cloud user association"
	default CLOUD_UA_BUTTONS
	help
		Select which method to use for nRF Cloud user association
		input.

config CLOUD_UA_BUTTONS
	bool "Use buttons and switches"
	help
		Use buttons and switches on the development kit to provide
		user association input.

config CLOUD_UA_CONSOLE
	bool "Use console input"
	help
		Use console to enter nRF Cloud user association input.
		Allowed input is as follows:
		'b1' = Button 1
		'b2' = Button 2
		's1' = Switch 1
		's2' = Switch 2

endchoice

config CLOUD_FOTA_APP
	bool "Enable firmware over-the-air upgrades for application"
	depends on AWS_FOTA
	depends on DFU_TARGET_MCUBOOT
	default y

config CLOUD_FOTA_MODEM
	bool "Enable firmware over-the-air upgrades for modem"
	depends on AWS_FOTA
	depends on DFU_TARGET_MODEM
	default y

endmenu # Cloud

menu "Environment sensors"

config USE_BME680_BSEC
	bool "Use Bosch BME680 BSEC lib"
	default n
	help
	  Enable use of Bosch BSEC library. The library itself is not a part of
	  NCS and must be downloaded from Bosch Sensortec.

config BOSCH_BSEC_LIBRARY_PATH
	string "Path to Bosch BSEC library folder"
	default "$(ZEPHYR_BASE)/../nrf/ext/BSEC_1.4.7.4_Generic_Release"
	help
	  Path to the folder where the Bosch BSEC library is placed.

config ENVIRONMENT_DATA_SEND_INTERVAL
	int "Interval in seconds for sending environment data"
	default 30
	help
	  Interval between each sampling and sending of environment sensor data.
	  If the GPS is active, sensor data will not be sent before it is
	  stopped. The unit is seconds.

config ENVIRONMENT_DATA_BACKOFF_TIME
	int "Time to delay sending environment data if GPS active"
	default 20
	help
	  Time in seconds before retrying to send environment sensor data if
	  the GPS is active.

choice
	prompt "Temperature measurement device"
	default TEMP_USE_SIM
	help
		Select which device will provide temperature data.

config TEMP_USE_SIM
	bool "Use simulated temperature data"
	select SENSOR
	select SENSOR_SIM
	help
		Use sensor simulator to generate temperature data to send to
		nRF Cloud.

config TEMP_USE_EXTERNAL
	bool "User provided temperature device"
	help
		The user provides a temperature device that is
		used for temperature measurement.

endchoice

if TEMP_USE_SIM
config TEMP_DEV_NAME
	string
	default SENSOR_SIM_DEV_NAME

config TEMP_TRIGGER
	bool
	default SENSOR_SIM_TRIGGER

config TEMP_SIM_BUTTON
	int "Button or switch to trigger 'data ready' event"
	range 1 4 if BOARD_NRF9160_PCA10090NS
	range 1 1 if BOARD_NRF9160_PCA20035NS
	default 3 if BOARD_NRF9160_PCA10090NS
	default 1 if BOARD_NRF9160_PCA20035NS
	help
		Button or switch number to use for triggering
		a 'data ready' event.
		1 - Button 1
		2 - Button 2
		3 - Switch 1
		4 - Switch 2
endif

if TEMP_USE_EXTERNAL

config TEMP_DEV_NAME
	string "Temperature device name"
	help
		Device from which temperature data will be fetched and
		sent to nRF Cloud.

endif

endmenu # Environment sensors

menuconfig LIGHT_SENSOR
	bool "Light sensor"
	select BH1749 if BOARD_NRF9160_PCA20035NS
	default y if BOARD_NRF9160_PCA20035NS

if LIGHT_SENSOR

config LIGHT_SENSOR_DEV_NAME
	string "Light sensor device name"
	default "BH1749" if BOARD_NRF9160_PCA20035NS

config LIGHT_SENSOR_DATA_SEND_INTERVAL
	int "Interval in seconds for sending light sensor data"
	default 60
	help
	  Interval between each sampling and sending of light sensor data.
	  If the GPS is active, sensor data will not be sent before it is
	  stopped. The unit is seconds.

endif # LIGHT_SENSOR

config GPS_START_AFTER_CLOUD_EVT_READY
	bool "Automatic start of GPS on CLOUD_EVT_READY event after reset"
	default n
	help
	  Enabling this will make the GPS automatically start after a reset.
	  Useful when operating as a GPS tracker outdoors for a longer period
	  of time.

config ASSET_TRACKER_WATCHDOG_TIMEOUT_MSEC
	int "Watchdog timeout in milliseconds"
	default 10000

config USE_AT_HOST
	bool "Enable AT commands"
	default y
	select AT_HOST_LIBRARY
	help
		Enable the AT host library so that AT commands can be sent to and
		received from a serial terminal.

endmenu

menu "Zephyr Kernel"
source "Kconfig.zephyr"
endmenu

module = ASSET_TRACKER
module-str = Asset Tracker
source "${ZEPHYR_BASE}/subsys/logging/Kconfig.template.log_config"
```

## prj.conf
```kconfig
#
# Copyright (c) 2019 Nordic Semiconductor ASA
#
# SPDX-License-Identifier: LicenseRef-BSD-5-Clause-Nordic
#
# General config
CONFIG_NEWLIB_LIBC=y
CONFIG_TEST_RANDOM_GENERATOR=y
CONFIG_ASSERT=y
CONFIG_REBOOT=y
CONFIG_LOG=y
CONFIG_LOG_IMMEDIATE=y
CONFIG_HW_STACK_PROTECTION=y

# Network
CONFIG_NETWORKING=y
CONFIG_NET_SOCKETS=y
CONFIG_NET_SOCKETS_OFFLOAD=y

# MQTT
CONFIG_MQTT_SOCKET_LIB=y
CONFIG_MQTT_LIB_TLS=y
CONFIG_MQTT_MAX_PACKET_LENGTH=2048

# LTE link control
CONFIG_POWER_OPTIMIZATION_ENABLE=n
CONFIG_LTE_LINK_CONTROL=y
CONFIG_LTE_AUTO_INIT_AND_CONNECT=n
CONFIG_LTE_LINK_CONTROL_LOG_LEVEL_DBG=y

CONFIG_LTE_NETWORK_MODE_NBIOT=n
CONFIG_LTE_LEGACY_PCO_MODE=n
CONFIG_LTE_PSM_REQ_RPTAU="00000110"
CONFIG_LTE_PSM_REQ_RAT="00000000"

# Modem info
CONFIG_MODEM_INFO=n

# BSD library
CONFIG_BSD_LIBRARY=y
CONFIG_BSD_LIBRARY_TRACE_ENABLED=n

# nRF Cloud
CONFIG_CLOUD_API=y
CONFIG_NRF_CLOUD=y
CONFIG_NRF_CLOUD_LOG_LEVEL_DBG=y

# Sensors
CONFIG_ACCEL_USE_SIM=y
CONFIG_TEMP_USE_SIM=y
CONFIG_BATTERY_MONITOR=n
CONFIG_CLOUD_BUTTON=n

# GPS
CONFIG_NRF9160_GPS=y
CONFIG_NRF9160_GPS_LOG_LEVEL_DBG=y
CONFIG_GPS_USE_EXTERNAL=y
CONFIG_GPS_DEV_NAME="NRF9160_GPS"

CONFIG_GPS_CONTROL=y
CONFIG_GPS_CONTROL_FIRST_FIX_CHECK_DELAY=10
CONFIG_GPS_CONTROL_FIX_COUNT=3
CONFIG_GPS_CONTROL_FIX_CHECK_INTERVAL=30
CONFIG_GPS_CONTROL_FIX_TRY_TIME=360
CONFIG_GPS_CONTROL_PSM_DISABLE_ON_STOP=n

# Library for buttons and LEDs
CONFIG_DK_LIBRARY=y
CONFIG_DK_LIBRARY_INVERT_LEDS=n

# Console
CONFIG_CONSOLE_SUBSYS=y
CONFIG_CONSOLE_HANDLER=y
CONFIG_CONSOLE_GETCHAR=y

# Main thread
CONFIG_MAIN_THREAD_PRIORITY=7

# Heap and stacks
CONFIG_HEAP_MEM_POOL_SIZE=16384
CONFIG_MAIN_STACK_SIZE=8192
CONFIG_SYSTEM_WORKQUEUE_STACK_SIZE=2048

# Settings
#CONFIG_FLASH=y
#CONFIG_FLASH_PAGE_LAYOUT=y
#CONFIG_FLASH_MAP=y
#CONFIG_FCB=y
#CONFIG_SETTINGS=y
#CONFIG_SETTINGS_FCB=y
#CONFIG_MPU_ALLOW_FLASH_WRITE=y

# Disable native network stack to save some memory
#CONFIG_NET_IPV4=n
#CONFIG_NET_IPV6=n
#CONFIG_NET_UDP=n
#CONFIG_NET_TCP=n

# MCUBOOT
CONFIG_BOOTLOADER_MCUBOOT=y
CONFIG_IMG_MANAGER=y
CONFIG_MCUBOOT_IMG_MANAGER=y
```

## prj_nrf9160_pca20035ns.conf
```kconfig
#
# Copyright (c) 2019 Nordic Semiconductor ASA
#
# SPDX-License-Identifier: LicenseRef-BSD-5-Clause-Nordic
#
# General config
CONFIG_NEWLIB_LIBC=y
CONFIG_NEWLIB_LIBC_FLOAT_PRINTF=y
CONFIG_TEST_RANDOM_GENERATOR=y
CONFIG_ASSERT=y
CONFIG_REBOOT=y
CONFIG_LOG=y
CONFIG_LOG_IMMEDIATE=y

# Network
CONFIG_NETWORKING=y
CONFIG_NET_NATIVE=n
CONFIG_NET_SOCKETS=y
CONFIG_NET_SOCKETS_OFFLOAD=y

# LTE link control
CONFIG_POWER_OPTIMIZATION_ENABLE=n
CONFIG_LTE_LINK_CONTROL=y
CONFIG_LTE_NETWORK_MODE_LTE_M_GPS=y
CONFIG_LTE_AUTO_INIT_AND_CONNECT=n
CONFIG_LTE_LINK_CONTROL_LOG_LEVEL_DBG=y

CONFIG_LTE_NETWORK_MODE_NBIOT=n
CONFIG_LTE_LEGACY_PCO_MODE=n
CONFIG_LTE_PSM_REQ_RPTAU="00000110"
CONFIG_LTE_PSM_REQ_RAT="00000000"

CONFIG_LTE_LOCK_BANDS=y
# Enable band 2, 3, 4, 8, 12, 13 ,20 and 28
CONFIG_LTE_LOCK_BAND_MASK="1000000010000001100010001110"

# Modem info
CONFIG_MODEM_INFO=y
CONFIG_MODEM_INFO_ADD_SIM_ICCID=n

# BSD library
CONFIG_BSD_LIBRARY=y
CONFIG_BSD_LIBRARY_TRACE_ENABLED=n

# nRF Cloud
CONFIG_CLOUD_API=y
CONFIG_NRF_CLOUD=y
CONFIG_NRF_CLOUD_LOG_LEVEL_DBG=y

# Sensors
CONFIG_SENSOR=y
CONFIG_ACCEL_USE_EXTERNAL=y
CONFIG_ACCEL_DEV_NAME="ADXL362"
CONFIG_ADXL362=y
CONFIG_ADXL362_TRIGGER_OWN_THREAD=y
CONFIG_ADXL362_ABS_REF_MODE=1
CONFIG_ADXL362_ACTIVITY_THRESHOLD=200
CONFIG_ADXL362_INACTIVITY_THRESHOLD=200
CONFIG_ADXL362_INTERRUPT_MODE=1
CONFIG_TEMP_USE_EXTERNAL=y
CONFIG_TEMP_DEV_NAME="BME680"

# Deselect CONFIG_BME680 if CONFIG_USE_BME680_BSEC is selected
CONFIG_BME680=y
CONFIG_USE_BME680_BSEC=n

CONFIG_SPI_NRFX_SPIM_MISO_NO_PULL=y

# GPS
CONFIG_NRF9160_GPS_LOG_LEVEL_DBG=y
CONFIG_NRF9160_GPS=y
CONFIG_NRF9160_GPS_LOG_LEVEL_DBG=y
CONFIG_GPS_USE_EXTERNAL=y
CONFIG_GPS_DEV_NAME="NRF9160_GPS"

CONFIG_GPS_CONTROL_FIRST_FIX_CHECK_DELAY=10
CONFIG_GPS_CONTROL_FIX_CHECK_INTERVAL=30
CONFIG_GPS_CONTROL_FIX_TRY_TIME=360
CONFIG_GPS_CONTROL_PSM_DISABLE_ON_STOP=n

# Library for buttons and LEDs
CONFIG_DK_LIBRARY=y
CONFIG_DK_LIBRARY_INVERT_LEDS=n

# Console
CONFIG_CLOUD_UA_BUTTONS=n
CONFIG_CLOUD_UA_CONSOLE=n
CONFIG_CONSOLE_SUBSYS=y
CONFIG_CONSOLE_HANDLER=y
CONFIG_CONSOLE_GETCHAR=y

# Main thread
CONFIG_MAIN_THREAD_PRIORITY=7

# AT CMD
CONFIG_AT_CMD_RESPONSE_MAX_LEN=4096

# FOTA
CONFIG_AWS_FOTA=y
CONFIG_AWS_JOBS_LOG_LEVEL_DBG=y
CONFIG_AWS_FOTA_LOG_LEVEL_DBG=y
CONFIG_DOWNLOAD_CLIENT_STACK_SIZE=4096
CONFIG_VERSION_STRING_MAX_LEN=128
CONFIG_IMG_MANAGER=y

# Enable DOWNLOAD libs
CONFIG_DOWNLOAD_CLIENT=y

# Heap and stacks
CONFIG_HEAP_MEM_POOL_SIZE=16384
CONFIG_MAIN_STACK_SIZE=8192
CONFIG_SYSTEM_WORKQUEUE_STACK_SIZE=2048
CONFIG_HW_STACK_PROTECTION=y

# Settings
CONFIG_FLASH=y
CONFIG_FLASH_PAGE_LAYOUT=y
CONFIG_FLASH_MAP=y
CONFIG_FCB=y
CONFIG_SETTINGS=y
CONFIG_SETTINGS_FCB=y
CONFIG_MPU_ALLOW_FLASH_WRITE=y

# MCUBOOT
CONFIG_BOOTLOADER_MCUBOOT=y
CONFIG_IMG_MANAGER=y
CONFIG_MCUBOOT_IMG_MANAGER=y
```

## src/eeprom.c
```c
#include <zephyr.h>
#include <stdio.h>
#include <drivers/i2c.h>
#include <logging/log.h>
LOG_MODULE_REGISTER(eeprom, 3);

static struct device *i2c_dev;
#define EEPROM_ADDR 0x50
#define BOARD_ID_MAGIC 0x24519142

struct board_id {
	u32_t magic;
	u32_t pca;
	u32_t version;
	u32_t checksum;
};

int board_id_make_checksum(struct board_id *board) {
	if (board == NULL) {
		return EINVAL;
	}

	board->checksum = board->magic ^ board->pca ^ board->version;
	return 0;
}

int app_i2c_init(void){
	u32_t i2c_cfg = I2C_SPEED_SET(I2C_SPEED_STANDARD) | I2C_MODE_MASTER;

	i2c_dev = device_get_binding(DT_NORDIC_NRF_TWIM_I2C_2_LABEL);
	return i2c_configure(i2c_dev,i2c_cfg);
}

bool eeprom_is_present(void){
	u8_t dummy_buf[1];
	int err;

	err = i2c_read(i2c_dev,dummy_buf,sizeof(dummy_buf),EEPROM_ADDR);
	if (err == 0){
		return true;
	}
	return false;
}

int eeprom_verify(u16_t addr, const void *buf, size_t len, bool *verified){
	int ret;
	u8_t read_byte;
	u8_t buf_addr[] = {(u8_t)((addr >> 8) & 0xFF), (u8_t)((addr) & 0xFF)};

	*verified = false;

	/* Set adress pointer */
	ret = i2c_write(i2c_dev, buf_addr, sizeof(buf_addr), EEPROM_ADDR);
	if (ret) {
		LOG_ERR("I2C write failed: %d.",ret);
		return ret;
	}

	for (size_t i = 0; i < len; i++){
		i2c_read(i2c_dev, &read_byte, 1, EEPROM_ADDR);
		if (ret) {
			LOG_ERR("I2C read failed: %d.",ret);
			return ret;
		}

		if (read_byte != ((u8_t*)buf)[i]){
			LOG_INF("EEPROM verification mismatch. 0x%x has 0x%x, should be 0x%x",addr+i,read_byte,((u8_t*)buf)[i]);
			return 0;
		}

		LOG_INF("Byte verified: 0x%x has 0x%x",addr+i,read_byte);

	}

	*verified = true;
	return 0;
}

int eeprom_write(u16_t addr, const void *buf, size_t len, bool verify){
	/* struct i2c_msg msg[2]; */
	u8_t tx_buffer[34]; /* Separate buffers unusable with Zephyr ATM? */
	bool verified;
	int ret;

	u8_t buf_addr[] = {(u8_t)((addr >> 8) & 0xFF), (u8_t)((addr) & 0xFF)};
	
	/* Separate buffers unusable with Zephyr ATM? */
	/*
	msg[0].buf = buf_addr;
	msg[0].len = sizeof(buf_addr);
	msg[0].flags = I2C_MSG_WRITE;

	msg[1].buf = buf;
	msg[1].len = len;
	msg[1].flags = I2C_MSG_WRITE | I2C_MSG_STOP;

	ret = i2c_transfer(i2c_dev, msg, 2, EEPROM_ADDR);
	*/

	memcpy(tx_buffer, buf_addr, 2);
	memcpy(tx_buffer + 2, buf, len);
	ret = i2c_write(i2c_dev, tx_buffer, len + 2, EEPROM_ADDR);
	if (ret) {
		LOG_ERR("I2C transfer failed: %d.",ret);
		return ret;
	}

	k_sleep(6); /* 5 ms is the maximum time to complete a write cycle */

	if (verify == false){
		return 0;
	}

	ret = eeprom_verify(addr, buf, len, &verified);
	if (ret) {
		LOG_ERR("EEPROM verification failed: %d.",ret);
		return ret;
	}

	if (verified == 0){
		LOG_ERR("EEPROM mismatch on verify after write");
		return -EIO;
	}

	return 0;
}

int eeprom_read(u16_t addr, void *buf, size_t len){
	u8_t buf_addr[] = {(u8_t)((addr >> 8) & 0xFF), (u8_t)((addr) & 0xFF)};
	return i2c_write_read(i2c_dev, EEPROM_ADDR, buf_addr, sizeof(addr), buf, len);
}

int eeprom_write_board_id(void){
	struct board_id board = {
		.magic = BOARD_ID_MAGIC,
		.pca = 20035,
		.version = 0x01040000,
	};
	int ret;

	board_id_make_checksum(&board);
	
	ret = eeprom_write(0x07E0, &board, sizeof(board), true);
	if (ret){
		LOG_ERR("Writing board ID failed: %d", ret);
		return ret;
	}

	return 0;
}

int eeprom_unprotect(void){
	u8_t buf = 0x40;
	int ret;
	
	ret = eeprom_write(0x8000, &buf, 1, false);
	if (ret){
		LOG_ERR("Unprotect failed: %d", ret);
		return ret;
	}

	ret = eeprom_read(0x8000, &buf, 1);
	if (ret){
		LOG_ERR("Unprotect verification failed: %d", ret);
		return ret;
	}

	
	if (buf != 0x00){
		LOG_ERR("Unprotect verification mismatch. Read value: 0x%x",buf);
		return -EIO;
	}

	return 0;
}

int eeprom_protect(void){
	const u8_t protect_upper_quarter = 0x48;
	const u8_t protect_upper_quarter_and_lock = 0x69;
	u8_t config_read;
	int ret;
	
	ret = eeprom_write(0x8000, &protect_upper_quarter, 1, false);
	if (ret){
		LOG_ERR("Protect failed: %d", ret);
		return ret;
	}

	ret = eeprom_read(0x8000, &config_read, 1);
	if (ret){
		LOG_ERR("Protect verification failed: %d", ret);
		return ret;
	}

	
	if (config_read != 0x08){ // 0x09 if locked
		LOG_ERR("Protect verification mismatch. Read value: 0x%x",config_read);
		return -EIO;
	}

	return 0;
}

int main(void){
	int ret;

	LOG_INF("EEPROM fw started");

	ret = app_i2c_init();
	LOG_INF("I2C Init->%d",ret);

	bool present = eeprom_is_present();
	LOG_INF("EEPROM Present: %d",present);

	ret = eeprom_write_board_id();
	LOG_INF("EEPROM write board ID->%d",ret);

	ret = eeprom_protect();
	LOG_INF("EEPROM protect->%d",ret);
}
```
